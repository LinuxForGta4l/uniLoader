## configs/gta4l_defconfig
```kconfig
CONFIG_POSITION_INDEPENDENT=y
CONFIG_LINUX_KRNL_HEADER_IMG=y
CONFIG_SM6115=y
CONFIG_SIMPLE_FB=y
CONFIG_SAMSUNG_GTA4L=y
CONFIG_TEXT_BASE=0x0
CONFIG_PAYLOAD_ENTRY=0x80000000
CONFIG_RAMDISK_ENTRY=0x4558b000
```
